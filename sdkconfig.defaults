## sdkconfig.defaults
```kconfig
#CONFIG_COMPONENT_HTTPD=y
#CONFIG_COMPONENT_MQTT=y
#CONFIG_COMPONENT_RELAY=y
#CONFIG_COMPONENT_OTA=y

CONFIG_MQTT_TASK_STACK_SIZE=4096
CONFIG_HTTP_SERVER_STACK_SIZE=4096
CONFIG_MQTT_BUFFER_SIZE=1024

# ESP Configs
CONFIG_ESP8266_DEFAULT_CPU_FREQ_80=y
CONFIG_ESP8266_DEFAULT_CPU_FREQ_MHZ=80

# Configure Basic Monitors
CONFIG_ESPTOOLPY_PORT="/dev/ttyS3"
CONFIG_ESPTOOLPY_BAUD_2MB=y
CONFIG_ESPTOOLPY_BAUD_OTHER_VAL=115200
CONFIG_ESPTOOLPY_BAUD=2000000
CONFIG_ESPTOOLPY_COMPRESSED=y
CONFIG_CONSOLE_UART_DEFAULT=y
CONFIG_ESP_CONSOLE_UART_DEFAULT=y
CONFIG_CONSOLE_UART_BAUDRATE=115200
CONFIG_ESP_CONSOLE_UART_BAUDRATE=115200
#CONFIG_CONSOLE_UART_BAUDRATE=9600
CONFIG_ESPTOOLPY_MONITOR_BAUD=115200
CONFIG_ESPTOOLPY_MONITOR_BAUD_115200B=y
CONFIG_ESPTOOLPY_MONITOR_BAUD_OTHER_VAL=115200

CONFIG_FLASHMODE_QIO=y
CONFIG_SPI_FLASH_MODE=0x0
CONFIG_ESPTOOLPY_FLASHMODE_QIO=y
CONFIG_ESPTOOLPY_FLASHMODE="qio"
CONFIG_ESPTOOLPY_FLASHSIZE_4MB=y
CONFIG_ESPTOOLPY_FLASHSIZE="4MB"
CONFIG_SPI_FLASH_SIZE=0x400000

CONFIG_PARTITION_TABLE_TWO_OTA=y
CONFIG_PARTITION_TABLE_FILENAME="partitions_two_ota.csv"

CONFIG_ESP_PHY_INIT_DATA_VDD33_CONST=255

CONFIG_OPTIMIZATION_LEVEL_RELEASE=y
CONFIG_OPTIMIZATION_ASSERTIONS_DISABLED=y
CONFIG_COMPILER_OPTIMIZATION_LEVEL_RELEASE=y
CONFIG_COMPILER_OPTIMIZATION_ASSERTIONS_DISABLE=y
CONFIG_COMPILER_STACK_CHECK_MODE_NONE=y
CONFIG_LOG_DEFAULT_LEVEL=0
CONFIG_LOG_DEFAULT_LEVEL_NONE=y

# ESP IDF Configs
CONFIG_HTTP_BUF_SIZE=1024
CONFIG_HTTPD_MAX_REQ_HDR_LEN=1024
CONFIG_HTTPD_MAX_URI_LEN=512
CONFIG_OTA_BUF_SIZE=512
CONFIG_OTA_ALLOW_HTTP=y

CONFIG_LWIP_DNS_SUPPORT_MDNS_QUERIES=n
CONFIG_LWIP_IP6_FRAG=n

# LWIP Config
CONFIG_LWIP_NETIF_LOOPBACK=n
CONFIG_LWIP_LOOPBACK_MAX_PBUFS=0

CONFIG_LWIP_ESP_LWIP_ASSERT=n

# MBED Config
CONFIG_ESP_TLS_USING_MBEDTLS=n
CONFIG_MBEDTLS_TLS_DISABLED=y
CONFIG_LIBSODIUM_USE_MBEDTLS_SHA=n

CONFIG_MBEDTLS_HAVE_TIME=n
CONFIG_MBEDTLS_TLS_SERVER_AND_CLIENT=n
CONFIG_MBEDTLS_ASYMMETRIC_CONTENT_LEN=n

# CONFIG_MBEDTLS_PEM_PARSE_C is not set
# CONFIG_MBEDTLS_PEM_WRITE_C is not set
# CONFIG_MBEDTLS_X509_CRL_PARSE_C is not set
# CONFIG_MBEDTLS_X509_CSR_PARSE_C is not set
# CONFIG_MBEDTLS_ECP_DP_SECP224R1_ENABLED is not set
# CONFIG_MBEDTLS_ECP_DP_SECP256R1_ENABLED is not set
# CONFIG_MBEDTLS_ECP_DP_SECP384R1_ENABLED is not set
# CONFIG_MBEDTLS_ECP_DP_SECP521R1_ENABLED is not set
# CONFIG_MBEDTLS_ECP_DP_SECP192K1_ENABLED is not set
# CONFIG_MBEDTLS_ECP_DP_SECP224K1_ENABLED is not set
# CONFIG_MBEDTLS_ECP_DP_SECP256K1_ENABLED is not set
# CONFIG_MBEDTLS_ECP_DP_BP256R1_ENABLED is not set
# CONFIG_MBEDTLS_ECP_DP_BP384R1_ENABLED is not set
# CONFIG_MBEDTLS_ECP_DP_BP512R1_ENABLED is not set
# CONFIG_MBEDTLS_ECP_DP_CURVE25519_ENABLED is not set
# CONFIG_MBEDTLS_ECP_NIST_OPTIM is not set
# CONFIG_util_assert is not set
CONFIG_ESP_SHA=n
CONFIG_ESP_ARC4=n

CONFIG_MQTT_TRANSPORT_SSL=n
CONFIG_MQTT_TRANSPORT_WEBSOCKET=n
CONFIG_VFS_SUPPORT_TERMIOS=n
CONFIG_SUPPORT_TERMIOS=n

CONFIG_ESP_HTTP_CLIENT_ENABLE_HTTPS=n
CONFIG_ESP8266_WIFI_ENABLE_WPA3_SAE=n
```
